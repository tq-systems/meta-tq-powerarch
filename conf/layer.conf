## conf/layer.conf
```bitbake
# We have a conf and classes directory, add to BBPATH
BBPATH .= ":${LAYERDIR}"

# We have recipes-* directories, add to BBFILES
BBFILES += "${LAYERDIR}/recipes-*/*/*.bb \
    ${LAYERDIR}/recipes-*/*/*.bbappend"

BBFILE_COLLECTIONS += "meta-tq-powerarch"
BBFILE_PATTERN_meta-tq-powerarch = "^${LAYERDIR}/"
BBFILE_PRIORITY_meta-tq-powerarch = "6"
```

## conf/machine/include/tq-default-settings.inc
```bitbake
# TQ BSP default settings

SDCARD_ROOTFS ?= "${DEPLOY_DIR_IMAGE}/${IMAGE_NAME}.rootfs.ext3"

NOR_ROOTFS ?= "${DEPLOY_DIR_IMAGE}/${IMAGE_NAME}.rootfs.jffs2"
JFFS2_ERASEBLOCK ?= "0x20000"

IMAGE_CLASSES += "image_types_tq"

IMAGE_TYPES += " nor sdcard"
```

## conf/machine/include/tqmt1040-stk-common.conf
```bitbake
include conf/machine/include/tq-default-settings.inc

SOC_FAMILY = "t1:t1040"

PREFERRED_PROVIDER_u-boot ?= "u-boot-tqmt104x"
PREFERRED_PROVIDER_virtual/bootloader ?= "u-boot-tqmt104x"
UBOOT_CONFIG ??= "sdcard nor"
UBOOT_CONFIG[nor] = "TQMT1040_defconfig"
UBOOT_CONFIG[sdcard] = "TQMT1040_SDCARD_defconfig"
FSL_RCW ?= "TQMT1040_SERDES66"
FSL_FMAN_UCODE ?= "fsl_fman_ucode_t1040_r1.1_107_4_2.bin"

KERNEL_DEFCONFIG ?= "${S}/arch/powerpc/configs/85xx/tqmt1040_defconfig" 
PREFERRED_PROVIDER_virtual/kernel ?= "linux-tqmt104x"
KERNEL_DEVICETREE ?= "fsl/tqmt1040.dtb"
```

## conf/machine/include/tqmt1042-stk-common.conf
```bitbake
include conf/machine/include/tq-default-settings.inc

SOC_FAMILY = "t1:t1042"

PREFERRED_PROVIDER_u-boot ?= "u-boot-tqmt104x"
PREFERRED_PROVIDER_virtual/bootloader ?= "u-boot-tqmt104x"
UBOOT_CONFIG ??= "sdcard nor"
UBOOT_CONFIG[nor] = "TQMT1042_defconfig"
UBOOT_CONFIG[sdcard] = "TQMT1042_SDCARD_defconfig"
FSL_RCW ?= "TQMT1042_SERDES86"
FSL_FMAN_UCODE ?= "fsl_fman_ucode_t1040_r1.1_107_4_2.bin"

KERNEL_DEFCONFIG ?= "${S}/arch/powerpc/configs/85xx/tqmt1042_defconfig" 
PREFERRED_PROVIDER_virtual/kernel ?= "linux-tqmt104x"
KERNEL_DEVICETREE ?= "fsl/tqmt1042.dtb"
```

## conf/machine/include/tqmt2081-stk-common.conf
```bitbake
include conf/machine/include/tq-default-settings.inc

SOC_FAMILY = "t2:t2081"

PREFERRED_PROVIDER_u-boot ?= "u-boot-tqmt2081"
PREFERRED_PROVIDER_virtual/bootloader ?= "u-boot-tqmt2081"
UBOOT_CONFIG ??= "sdcard nor"
UBOOT_CONFIG[nor] = "TQMT2081_defconfig"
UBOOT_CONFIG[sdcard] = "TQMT2081_SDCARD_defconfig"
FSL_RCW ?= "TQMT2081_SERDES71"
FSL_FMAN_UCODE ?= "fsl_fman_ucode_t2080_r1.1_108_4_2.bin"

KERNEL_DEFCONFIG ?= "${S}/arch/powerpc/configs/85xx/tqmt2081_defconfig"
PREFERRED_PROVIDER_virtual/kernel ?= "linux-tqmt2081"
KERNEL_DEVICETREE ?= "fsl/tqmt2081.dtb"
```

## conf/machine/tqmt1040-64b-stk.conf
```bitbake
#@TYPE: Machine
#@NAME: TQMT104x-64B Starter Kit
#@SOC: tqmt1040
#@DESCRIPTION: Machine configuration for the TQMT104x Starter Kit in 64-bit mode
#@MAINTAINER: Konrad Gräfe <k.graefe@gateware.de>

KERNEL_DEFCONFIG ?= "${S}/arch/powerpc/configs/85xx/tqmt1042_64_defconfig" 

include conf/machine/include/tqmt1040-stk-common.conf

IMAGE_INSTALL_append = " uio-seville"

require conf/machine/include/e5500-64b.inc

PREFERRED_VERSION_openssl = ""
```

## conf/machine/tqmt1040-stk.conf
```bitbake
#@TYPE: Machine
#@NAME: TQMT104x Starter Kit
#@SOC: tqmt1040
#@DESCRIPTION: Machine configuration for the TQMT104x Starter Kit in 32-bit mode
#@MAINTAINER: Konrad Gräfe <k.graefe@gateware.de>

include conf/machine/include/tqmt1040-stk-common.conf

require conf/machine/include/e5500.inc

PREFERRED_VERSION_openssl = ""
```

## conf/machine/tqmt1042-64b-stk.conf
```bitbake
#@TYPE: Machine
#@NAME: TQMT1042-64B Starter Kit
#@SOC: tqmt1042
#@DESCRIPTION: Machine configuration for the TQMT1042 Starter Kit in 64-bit mode
#@MAINTAINER: Konrad Gräfe <k.graefe@gateware.de>

KERNEL_DEFCONFIG ?= "${S}/arch/powerpc/configs/85xx/tqmt1042_64_defconfig" 

include conf/machine/include/tqmt1042-stk-common.conf

require conf/machine/include/e5500-64b.inc

PREFERRED_VERSION_openssl = ""
```

## conf/machine/tqmt1042-stk.conf
```bitbake
#@TYPE: Machine
#@NAME: TQMT1042 Starter Kit
#@SOC: tqmt1042
#@DESCRIPTION: Machine configuration for the TQMT1042 Starter Kit in 32-bit mode
#@MAINTAINER: Konrad Gräfe <k.graefe@gateware.de>

include conf/machine/include/tqmt1042-stk-common.conf

require conf/machine/include/e5500.inc

PREFERRED_VERSION_openssl = ""
```

## conf/machine/tqmt2081-64b-stk.conf
```bitbake
#@TYPE: Machine
#@NAME: TQMT2081-64B Starter Kit
#@SOC: tqmt2081
#@DESCRIPTION: Machine configuration for the TQMT2081 Starter Kit in 64-bit mode
#@MAINTAINER: Konrad Gräfe <k.graefe@gateware.de>

KERNEL_DEFCONFIG ?= "${S}/arch/powerpc/configs/85xx/tqmt2081_64_defconfig" 

include conf/machine/include/tqmt2081-stk-common.conf

require conf/machine/include/e5500-64b.inc

PREFERRED_VERSION_openssl = ""
```

## conf/machine/tqmt2081-stk.conf
```bitbake
#@TYPE: Machine
#@NAME: TQMT2081 Starter Kit
#@SOC: tqmt2081
#@DESCRIPTION: Machine configuration for the TQMT2081 Starter Kit in 32-bit mode
#@MAINTAINER: Konrad Gräfe <k.graefe@gateware.de>

include conf/machine/include/tqmt2081-stk-common.conf

require conf/machine/include/e5500.inc

PREFERRED_VERSION_openssl = ""
```
